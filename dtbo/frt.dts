/dts-v1/;

/ {

	fragment@0 {
		target = <0xffffffff>;

		__overlay__ {

			lcm_params {
				compatible = "mediatek,lcm_params-otm9608a_qhd_dsi_cmd";
				lcm_params-types = <0x02 0x00 0x00 0x00>;
				lcm_params-resolution = <0x21c 0x3c0>;
				lcm_params-io_select_mode;
				lcm_params-dbi-port;
				lcm_params-dbi-clock_freq;
				lcm_params-dbi-data_width;
				lcm_params-dbi-data_format = <0x00 0x00 0x00 0x00 0x00>;
				lcm_params-dbi-cpu_write_bits;
				lcm_params-dbi-io_driving_current;
				lcm_params-dbi-msb_io_driving_current;
				lcm_params-dbi-ctrl_io_driving_current;
				lcm_params-dbi-te_mode = <0x01>;
				lcm_params-dbi-te_edge_polarity = <0x00>;
				lcm_params-dbi-te_hs_delay_cnt;
				lcm_params-dbi-te_vs_width_cnt;
				lcm_params-dbi-te_vs_width_cnt_div;
				lcm_params-dbi-serial-params0 = <0x00 0x00 0x00 0x00 0x00 0x00>;
				lcm_params-dbi-serial-params1 = <0x00 0x00 0x00 0x00 0x00 0x00>;
				lcm_params-dbi-serial-params2 = <0x00 0x00 0x00 0x00 0x00 0x00>;
				lcm_params-dbi-parallel-params0 = <0x00 0x00 0x00 0x00>;
				lcm_params-dbi-parallel-params1 = <0x00 0x00 0x00 0x00>;
				lcm_params-dpi-mipi_pll_clk_ref;
				lcm_params-dpi-mipi_pll_clk_div1;
				lcm_params-dpi-mipi_pll_clk_div2;
				lcm_params-dpi-mipi_pll_clk_fbk_div;
				lcm_params-dpi-dpi_clk_div;
				lcm_params-dpi-dpi_clk_duty;
				lcm_params-dpi-PLL_CLOCK;
				lcm_params-dpi-dpi_clock;
				lcm_params-dpi-ssc_disable;
				lcm_params-dpi-ssc_range;
				lcm_params-dpi-width;
				lcm_params-dpi-height;
				lcm_params-dpi-bg_width;
				lcm_params-dpi-bg_height;
				lcm_params-dpi-clk_pol;
				lcm_params-dpi-de_pol;
				lcm_params-dpi-vsync_pol;
				lcm_params-dpi-hsync_pol;
				lcm_params-dpi-hsync_pulse_width;
				lcm_params-dpi-hsync_back_porch;
				lcm_params-dpi-hsync_front_porch;
				lcm_params-dpi-vsync_pulse_width;
				lcm_params-dpi-vsync_back_porch;
				lcm_params-dpi-vsync_front_porch;
				lcm_params-dpi-format;
				lcm_params-dpi-rgb_order;
				lcm_params-dpi-is_serial_output;
				lcm_params-dpi-i2x_en;
				lcm_params-dpi-i2x_edge;
				lcm_params-dpi-embsync;
				lcm_params-dpi-lvds_tx_en;
				lcm_params-dpi-bit_swap;
				lcm_params-dpi-intermediat_buffer_num;
				lcm_params-dpi-io_driving_current;
				lcm_params-dpi-lsb_io_driving_current;
				lcm_params-dsi-mode = <0x00>;
				lcm_params-dsi-switch_mode = <0x01>;
				lcm_params-dsi-DSI_WMEM_CONTI = <0x3c>;
				lcm_params-dsi-DSI_RMEM_CONTI = <0x3e>;
				lcm_params-dsi-VC_NUM;
				lcm_params-dsi-lane_num = <0x02>;
				lcm_params-dsi-data_format = <0x00 0x00 0x00 0x02>;
				lcm_params-dsi-intermediat_buffer_num = <0x02>;
				lcm_params-dsi-ps = <0x02>;
				lcm_params-dsi-word_count;
				lcm_params-dsi-packet_size = <0x100>;
				lcm_params-dsi-vertical_sync_active;
				lcm_params-dsi-vertical_backporch;
				lcm_params-dsi-vertical_frontporch;
				lcm_params-dsi-vertical_frontporch_for_low_power;
				lcm_params-dsi-vertical_active_line;
				lcm_params-dsi-horizontal_sync_active;
				lcm_params-dsi-horizontal_backporch;
				lcm_params-dsi-horizontal_frontporch;
				lcm_params-dsi-horizontal_blanking_pixel;
				lcm_params-dsi-horizontal_active_pixel;
				lcm_params-dsi-horizontal_bllp;
				lcm_params-dsi-line_byte;
				lcm_params-dsi-horizontal_sync_active_byte;
				lcm_params-dsi-horizontal_backportch_byte;
				lcm_params-dsi-horizontal_frontporch_byte;
				lcm_params-dsi-rgb_byte;
				lcm_params-dsi-horizontal_sync_active_word_count;
				lcm_params-dsi-horizontal_backporch_word_count;
				lcm_params-dsi-horizontal_frontporch_word_count;
				lcm_params-dsi-HS_TRAIL;
				lcm_params-dsi-ZERO;
				lcm_params-dsi-HS_PRPR;
				lcm_params-dsi-LPX;
				lcm_params-dsi-TA_SACK;
				lcm_params-dsi-TA_GET;
				lcm_params-dsi-TA_SURE;
				lcm_params-dsi-TA_GO;
				lcm_params-dsi-CLK_TRAIL;
				lcm_params-dsi-CLK_ZERO;
				lcm_params-dsi-LPX_WAIT;
				lcm_params-dsi-CONT_DET;
				lcm_params-dsi-CLK_HS_PRPR;
				lcm_params-dsi-CLK_HS_POST;
				lcm_params-dsi-DA_HS_EXIT;
				lcm_params-dsi-CLK_HS_EXIT;
				lcm_params-dsi-pll_select;
				lcm_params-dsi-pll_div1;
				lcm_params-dsi-pll_div2;
				lcm_params-dsi-fbk_div;
				lcm_params-dsi-fbk_sel;
				lcm_params-dsi-rg_bir;
				lcm_params-dsi-rg_bic;
				lcm_params-dsi-rg_bp;
				lcm_params-dsi-pll_clock = <0x104>;
				lcm_params-dsi-dsi_clock;
				lcm_params-dsi-ssc_disable;
				lcm_params-dsi-ssc_range;
				lcm_params-dsi-compatibility_for_nvk;
				lcm_params-dsi-cont_clock;
				lcm_params-dsi-ufoe_enable;
				lcm_params-dsi-ufoe_params = <0x00 0x00 0x00 0x00>;
				lcm_params-dsi-edp_panel;
				lcm_params-dsi-customization_esd_check_enable = <0x00>;
				lcm_params-dsi-esd_check_enable = <0x01>;
				lcm_params-dsi-lcm_int_te_monitor;
				lcm_params-dsi-lcm_int_te_period;
				lcm_params-dsi-lcm_ext_te_monitor;
				lcm_params-dsi-lcm_ext_te_enable;
				lcm_params-dsi-noncont_clock;
				lcm_params-dsi-noncont_clock_period;
				lcm_params-dsi-clk_lp_per_line_enable = <0x00>;
				lcm_params-dsi-lcm_esd_check_table0 = <0x0a 0x01 0x9c 0x00>;
				lcm_params-dsi-lcm_esd_check_table1;
				lcm_params-dsi-lcm_esd_check_table2;
				lcm_params-dsi-switch_mode_enable;
				lcm_params-dsi-dual_dsi_type;
				lcm_params-dsi-lane_swap_en;
				lcm_params-dsi-lane_swap0 = <0x00 0x00 0x00 0x00 0x00 0x00>;
				lcm_params-dsi-lane_swap1 = <0x00 0x00 0x00 0x00 0x00 0x00>;
				lcm_params-dsi-vertical_vfp_lp;
				lcm_params-physical_width = <0x3b>;
				lcm_params-physical_height = <0x68>;
				lcm_params-physical_width_um = <0xe86c>;
				lcm_params-physical_height_um = <0x198fc>;
				lcm_params-od_table_size;
				lcm_params-od_table;
			};

			lcm_ops {
				compatible = "mediatek,lcm_ops-otm9608a_qhd_dsi_cmd";
				init = <0x03 0x01 0x01 0x00 0x03 0x02 0x01 0x0a 0x03 0x01 0x01 0x01 0x03 0x02 0x01 0x0a 0x04 0x05 0x03 0x00 0x01 0x00 0x04 0x05 0x05 0xff 0x03 0x96 0x08 0x01 0x04 0x05 0x03 0x00 0x01 0x80 0x04 0x05 0x04 0xff 0x02 0x96 0x08 0x04 0x05 0x03 0x00 0x01 0x00 0x04 0x05 0x03 0xa0 0x01 0x00 0x04 0x05 0x03 0x00 0x01 0x80 0x04 0x05 0x07 0xb3 0x05 0x00 0x00 0x20 0x00 0x00 0x04 0x05 0x03 0x00 0x01 0xc0 0x04 0x05 0x03 0xb3 0x01 0x09 0x04 0x05 0x03 0x00 0x01 0x80 0x04 0x05 0x0b 0xc0 0x09 0x00 0x4c 0x00 0x10 0x10 0x00 0x47 0x10 0x10 0x04 0x05 0x03 0x00 0x01 0x92 0x04 0x05 0x06 0xc0 0x04 0x00 0x10 0x00 0x13 0x04 0x05 0x03 0x00 0x01 0xa2 0x04 0x05 0x05 0xc0 0x03 0x0c 0x05 0x02 0x04 0x05 0x03 0x00 0x01 0xb3 0x04 0x05 0x04 0xc0 0x02 0x00 0x50 0x04 0x05 0x03 0x00 0x01 0x81 0x04 0x05 0x03 0xc1 0x01 0x66 0x04 0x05 0x03 0x00 0x01 0x80 0x04 0x05 0x05 0xc4 0x03 0x00 0x84 0xfc 0x04 0x05 0x03 0x00 0x01 0xa0 0x04 0x05 0x04 0xb3 0x02 0x10 0x00 0x04 0x05 0x03 0x00 0x01 0xa0 0x04 0x05 0x03 0xc0 0x01 0x00 0x04 0x05 0x03 0x00 0x01 0x88 0x04 0x05 0x03 0xc4 0x01 0x40 0x04 0x05 0x03 0x00 0x01 0xa0 0x04 0x05 0x0a 0xc4 0x08 0x33 0x09 0x90 0x2b 0x33 0x09 0x90 0x54 0x04 0x05 0x03 0x00 0x01 0x80 0x04 0x05 0x06 0xc5 0x04 0x08 0x00 0xa0 0x11 0x04 0x05 0x03 0x00 0x01 0x90 0x04 0x05 0x09 0xc5 0x07 0x96 0x57 0x01 0x57 0x33 0x33 0x34 0x04 0x05 0x03 0x00 0x01 0xa0 0x04 0x05 0x09 0xc5 0x07 0x96 0x57 0x00 0x57 0x33 0x33 0x34 0x04 0x05 0x03 0x00 0x01 0xb0 0x04 0x05 0x09 0xc5 0x07 0x04 0xac 0x01 0x00 0x71 0xb1 0x83 0x04 0x05 0x03 0x00 0x01 0x00 0x04 0x05 0x03 0xd9 0x01 0x61 0x04 0x05 0x03 0x00 0x01 0x80 0x04 0x05 0x03 0xc6 0x01 0x64 0x04 0x05 0x03 0x00 0x01 0xb0 0x04 0x05 0x07 0xc6 0x05 0x03 0x10 0x00 0x1f 0x12 0x04 0x05 0x03 0x00 0x01 0x00 0x04 0x05 0x03 0xd0 0x01 0x40 0x04 0x05 0x03 0x00 0x01 0x00 0x04 0x05 0x04 0xd1 0x02 0x00 0x00 0x04 0x05 0x03 0x00 0x01 0xb7 0x04 0x05 0x03 0xb0 0x01 0x10 0x04 0x05 0x03 0x00 0x01 0xc0 0x04 0x05 0x03 0xb0 0x01 0x55 0x04 0x05 0x03 0x00 0x01 0xb1 0x04 0x05 0x03 0xb0 0x01 0x03 0x04 0x05 0x03 0x00 0x01 0x81 0x04 0x05 0x03 0xd6 0x01 0x00 0x04 0x05 0x03 0x00 0x01 0x00 0x04 0x05 0x12 0xe1 0x10 0x01 0x07 0x0b 0x0c 0x05 0x0d 0x0a 0x08 0x06 0x08 0x0d 0x06 0x0d 0x16 0x10 0x01 0x04 0x05 0x03 0x00 0x01 0x00 0x04 0x05 0x12 0xe2 0x10 0x02 0x06 0x0a 0x0d 0x05 0x0c 0x09 0x08 0x05 0x08 0x0e 0x07 0x0d 0x16 0x10 0x00 0x04 0x05 0x03 0x00 0x01 0x80 0x04 0x05 0x0c 0xcb 0x0a 0x00 0x00 0x00 0x00 0x00 0x00 0x00 0x00 0x00 0x00 0x04 0x05 0x03 0x00 0x01 0x90 0x04 0x05 0x11 0xcb 0x0f 0x00 0x00 0x00 0x00 0x00 0x00 0x00 0x00 0x00 0x00 0x00 0x00 0x00 0x00 0x00 0x04 0x05 0x03 0x00 0x01 0xa0 0x04 0x05 0x11 0xcb 0x0f 0x00 0x00 0x00 0x00 0x00 0x00 0x00 0x00 0x00 0x00 0x00 0x00 0x00 0x00 0x00 0x04 0x05 0x03 0x00 0x01 0xb0 0x04 0x05 0x0c 0xcb 0x0a 0x00 0x00 0x00 0x00 0x00 0x00 0x00 0x00 0x00 0x00 0x04 0x05 0x03 0x00 0x01 0xc0 0x04 0x05 0x11 0xcb 0x0f 0x04 0x04 0x04 0x04 0x08 0x04 0x08 0x04 0x08 0x04 0x08 0x04 0x04 0x04 0x08 0x04 0x05 0x03 0x00 0x01 0xd0 0x04 0x05 0x11 0xcb 0x0f 0x08 0x00 0x00 0x00 0x00 0x04 0x04 0x04 0x04 0x08 0x04 0x08 0x04 0x08 0x04 0x04 0x05 0x03 0x00 0x01 0xe0 0x04 0x05 0x0c 0xcb 0x0a 0x08 0x04 0x04 0x04 0x08 0x08 0x00 0x00 0x00 0x00 0x04 0x05 0x03 0x00 0x01 0xf0 0x04 0x05 0x0c 0xcb 0x0a 0xff 0xff 0xff 0xff 0xff 0xff 0xff 0xff 0xff 0xff 0x04 0x05 0x03 0x00 0x01 0x80 0x04 0x05 0x0c 0xcc 0x0a 0x26 0x25 0x23 0x24 0x00 0x0f 0x00 0x0d 0x00 0x0b 0x04 0x05 0x03 0x00 0x01 0x90 0x04 0x05 0x11 0xcc 0x0f 0x00 0x09 0x01 0x03 0x00 0x00 0x00 0x00 0x00 0x00 0x26 0x25 0x21 0x22 0x00 0x04 0x05 0x03 0x00 0x01 0xa0 0x04 0x05 0x11 0xcc 0x0f 0x10 0x00 0x0e 0x00 0x0c 0x00 0x0a 0x02 0x04 0x00 0x00 0x00 0x00 0x00 0x00 0x04 0x05 0x03 0x00 0x01 0xb0 0x04 0x05 0x0c 0xcc 0x0a 0x25 0x26 0x21 0x22 0x00 0x0a 0x00 0x0c 0x00 0x0e 0x04 0x05 0x03 0x00 0x01 0xc0 0x04 0x05 0x11 0xcc 0x0f 0x00 0x10 0x04 0x02 0x00 0x00 0x00 0x00 0x00 0x00 0x25 0x26 0x23 0x24 0x00 0x04 0x05 0x03 0x00 0x01 0xd0 0x04 0x05 0x11 0xcc 0x0f 0x09 0x00 0x0b 0x00 0x0d 0x00 0x0f 0x03 0x01 0x00 0x00 0x00 0x00 0x00 0x00 0x04 0x05 0x03 0x00 0x01 0x80 0x04 0x05 0x0e 0xce 0x0c 0x8a 0x03 0x06 0x89 0x03 0x06 0x88 0x03 0x06 0x87 0x03 0x06 0x04 0x05 0x03 0x00 0x01 0x90 0x04 0x05 0x10 0xce 0x0e 0xf0 0x00 0x00 0xf0 0x00 0x00 0xf0 0x00 0x00 0xf0 0x00 0x00 0x00 0x00 0x04 0x05 0x03 0x00 0x01 0xa0 0x04 0x05 0x10 0xce 0x0e 0x38 0x02 0x03 0xc1 0x00 0x06 0x00 0x38 0x01 0x03 0xc2 0x00 0x06 0x00 0x04 0x05 0x03 0x00 0x01 0xb0 0x04 0x05 0x10 0xce 0x0e 0x38 0x00 0x03 0xc3 0x00 0x06 0x00 0x30 0x00 0x03 0xc4 0x00 0x06 0x00 0x04 0x05 0x03 0x00 0x01 0xc0 0x04 0x05 0x10 0xce 0x0e 0x38 0x06 0x03 0xbd 0x00 0x06 0x00 0x38 0x05 0x03 0xbe 0x00 0x06 0x00 0x04 0x05 0x03 0x00 0x01 0xd0 0x04 0x05 0x10 0xce 0x0e 0x38 0x04 0x03 0xbf 0x00 0x06 0x00 0x38 0x03 0x03 0xc0 0x00 0x06 0x00 0x04 0x05 0x03 0x00 0x01 0x80 0x04 0x05 0x10 0xcf 0x0e 0xf0 0x00 0x00 0x10 0x00 0x00 0x00 0xf0 0x00 0x00 0x10 0x00 0x00 0x00 0x04 0x05 0x03 0x00 0x01 0x90 0x04 0x05 0x10 0xcf 0x0e 0xf0 0x00 0x00 0x10 0x00 0x00 0x00 0xf0 0x00 0x00 0x10 0x00 0x00 0x00 0x04 0x05 0x03 0x00 0x01 0xa0 0x04 0x05 0x10 0xcf 0x0e 0xf0 0x00 0x00 0x10 0x00 0x00 0x00 0xf0 0x00 0x00 0x10 0x00 0x00 0x00 0x04 0x05 0x03 0x00 0x01 0xb0 0x04 0x05 0x10 0xcf 0x0e 0xf0 0x00 0x00 0x10 0x00 0x00 0x00 0xf0 0x00 0x00 0x10 0x00 0x00 0x00 0x04 0x05 0x03 0x00 0x01 0xc0 0x04 0x05 0x0c 0xcf 0x0a 0x02 0x02 0x20 0x20 0x00 0x00 0x01 0x00 0x00 0x02 0x04 0x05 0x03 0x00 0x01 0x00 0x04 0x05 0x04 0xd8 0x02 0x67 0x67 0x04 0x05 0x02 0x11 0x00 0x03 0x02 0x01 0x78 0x04 0x05 0x03 0x35 0x01 0x00 0x04 0x05 0x02 0x29 0x00 0x03 0x02 0x01 0x28>;
				compare_id = <0x04 0x04 0x05 0x01 0x00 0x37 0x03 0x00 0x04 0x07 0x03 0xda 0x01 0x96 0x04 0x04 0x05 0x01 0x00 0x37 0x03 0x00 0x04 0x07 0x03 0xdb 0x01 0x08 0x04 0x04 0x05 0x01 0x00 0x37 0x03 0x00 0x04 0x07 0x03 0xdc 0x01 0x00>;
				suspend = <0x04 0x05 0x02 0x28 0x00 0x03 0x02 0x01 0x0a 0x04 0x05 0x02 0x10 0x00 0x03 0x02 0x01 0x78>;
				backlight = <0x04 0x05 0x03 0x51 0x01 0xff>;
			};
		};
	};

	fragment@1 {
		target = <0xffffffff>;

		__overlay__ {
			#address-cells = <0x01>;
			#size-cells = <0x00>;

			cpu@000 {
				device_type = "cpu";
				compatible = "arm,cortex-a53";
				reg = <0x00>;
				enable-method = "spin-table";
				cpu-release-addr = <0x00 0x40000200>;
				clock-frequency = <0x4190ab00>;
				linux,phandle = <0x2e>;
				phandle = <0x2e>;
			};

			cpu@001 {
				device_type = "cpu";
				compatible = "arm,cortex-a53";
				reg = <0x01>;
				enable-method = "spin-table";
				cpu-release-addr = <0x00 0x40000200>;
				clock-frequency = <0x4190ab00>;
				linux,phandle = <0x2f>;
				phandle = <0x2f>;
			};

			cpu@002 {
				device_type = "cpu";
				compatible = "arm,cortex-a53";
				reg = <0x02>;
				enable-method = "spin-table";
				cpu-release-addr = <0x00 0x40000200>;
				clock-frequency = <0x4190ab00>;
				linux,phandle = <0x30>;
				phandle = <0x30>;
			};

			cpu@003 {
				device_type = "cpu";
				compatible = "arm,cortex-a53";
				reg = <0x03>;
				enable-method = "spin-table";
				cpu-release-addr = <0x00 0x40000200>;
				clock-frequency = <0x4190ab00>;
				linux,phandle = <0x31>;
				phandle = <0x31>;
			};
		};
	};

	fragment@2 {
		target = <0xffffffff>;

		__overlay__ {

			MALI@0x13040000 {
				compatible = "arm,malit720\0arm,mali-t72x\0arm,malit7xx\0arm,mali-midgard";
				reg = <0x13040000 0x4000>;
				interrupts = <0x00 0xd4 0x08 0x00 0xd3 0x08 0x00 0xd2 0x08>;
				interrupt-names = "JOB\0MMU\0GPU";
				clock-frequency = <0x20c85580>;
			};

			MTKFB@5e200000 {
				compatible = "mediatek,MTKFB";
				reg = <0x7f000000 0x1000000>;
			};
		};
	};

	fragment@3 {
		target = <0xffffffff>;

		__overlay__ {

			led@0 {
				compatible = "mediatek,red";
				led_mode = <0x00>;
				data = <0x01>;
				pwm_config = <0x00 0x00 0x00 0x00 0x00>;
				linux,phandle = <0x32>;
				phandle = <0x32>;
			};

			led@1 {
				compatible = "mediatek,green";
				led_mode = <0x00>;
				data = <0x01>;
				pwm_config = <0x00 0x00 0x00 0x00 0x00>;
				linux,phandle = <0x33>;
				phandle = <0x33>;
			};

			led@2 {
				compatible = "mediatek,blue";
				led_mode = <0x00>;
				data = <0x01>;
				pwm_config = <0x00 0x00 0x00 0x00 0x00>;
				linux,phandle = <0x34>;
				phandle = <0x34>;
			};

			led@3 {
				compatible = "mediatek,jogball-backlight";
				led_mode = <0x00>;
				data = <0x01>;
				pwm_config = <0x00 0x00 0x00 0x00 0x00>;
				linux,phandle = <0x35>;
				phandle = <0x35>;
			};

			led@4 {
				compatible = "mediatek,keyboard-backlight";
				led_mode = <0x00>;
				data = <0x01>;
				pwm_config = <0x00 0x00 0x00 0x00 0x00>;
				linux,phandle = <0x36>;
				phandle = <0x36>;
			};

			led@5 {
				compatible = "mediatek,button-backlight";
				led_mode = <0x00>;
				data = <0x01>;
				pwm_config = <0x00 0x00 0x00 0x00 0x00>;
				linux,phandle = <0x37>;
				phandle = <0x37>;
			};

			led@6 {
				compatible = "mediatek,lcd-backlight";
				led_mode = <0x05>;
				data = <0x01>;
				pwm_config = <0x00 0x00 0x00 0x00 0x00>;
				linux,phandle = <0x38>;
				phandle = <0x38>;
			};

			kd_camera_flashlight@0 {
				compatible = "mediatek,camera_flashlight";
				pinctrl-names = "default\0flash0_state0\0flash0_state1\0flash1_state0\0flash1_state1";
				pinctrl-0 = <0x01>;
				pinctrl-1 = <0x02>;
				pinctrl-2 = <0x03>;
				pinctrl-3 = <0x04>;
				pinctrl-4 = <0x05>;
				status = "okay";
				linux,phandle = <0x39>;
				phandle = <0x39>;
			};

			vibrator@0 {
				compatible = "mediatek,vibrator";
				vib_timer = <0x19>;
				vib_limit = <0x09>;
				vib_vol = <0x05>;
				linux,phandle = <0x3a>;
				phandle = <0x3a>;
			};
		};
	};

	fragment@4 {
		target = <0xffffffff>;

		__overlay__ {

			goodix_touch@14 {
				compatible = "mediatek,goodix_touch";
				reg = <0x14>;
				status = "okay";
			};
		};
	};

	fragment@5 {
		target = <0xffffffff>;

		__overlay__ {

			gsensor@18 {
				i2c_num = <0x02>;
				i2c_addr = <0x18 0x00 0x00 0x00>;
				direction = <0x03>;
				power_id = <0xffff>;
				power_vol = <0x00>;
				firlen = <0x00>;
				is_batch_supported = <0x00>;
			};

			msensor@0d {
				i2c_num = <0x02>;
				i2c_addr = <0x0d 0x00 0x00 0x00>;
				direction = <0x01>;
				power_id = <0xffff>;
				power_vol = <0x00>;
				is_batch_supported = <0x00>;
			};

			gyro@68 {
				i2c_num = <0x02>;
				i2c_addr = <0x68 0x00 0x00 0x00>;
				direction = <0x03>;
				power_id = <0xffff>;
				power_vol = <0x00>;
				firlen = <0x00>;
				is_batch_supported = <0x00>;
			};

			alsps@23 {
				pinctrl-names = "pin_default\0pin_cfg";
				pinctrl-0 = <0x06>;
				pinctrl-1 = <0x07>;
				status = "okay";
				i2c_num = <0x02>;
				i2c_addr = <0x23 0x00 0x00 0x00>;
				polling_mode_ps = <0x00>;
				polling_mode_als = <0x01>;
				power_id = <0xffff>;
				power_vol = <0x00>;
				als_level = <0x00 0x1e 0x64 0xc8 0x148 0x35d 0x561 0xc35 0x1e29 0x1e57 0x314d 0x5a16 0x6f0e 0x81fa 0xb80c>;
				als_value = <0x00 0x15 0x30 0x6e 0x85 0x130 0x1f6 0x3ec 0x7d5 0xbf2 0x138d 0x1f48 0x271a 0x2ee0 0x3e80 0x4e20>;
				ps_threshold_high = <0x2bc>;
				ps_threshold_low = <0x12c>;
				is_batch_supported_ps = <0x00>;
				is_batch_supported_als = <0x00>;
			};

			nfc@27 {
				compatible = "samsung,nfc";
				reg = <0x27>;
				status = "okay";
				linux,phandle = <0x3b>;
				phandle = <0x3b>;
			};
		};
	};

	fragment@6 {
		target = <0xffffffff>;

		__overlay__ {

			alspspincfg {
				linux,phandle = <0x07>;
				phandle = <0x07>;

				pins_cmd_dat {
					pinmux = <0x4100>;
					slew-rate = <0x00>;
					bias-pull-up = <0x00>;
				};
			};

			alspsdefaultcfg {
				linux,phandle = <0x06>;
				phandle = <0x06>;
			};

			gyropincfg {
				linux,phandle = <0x09>;
				phandle = <0x09>;

				pins_cmd_dat {
					pinmux = <0x4300>;
					slew-rate = <0x00>;
					bias-pull-down = <0x00>;
				};
			};

			gyrodefaultcfg {
				linux,phandle = <0x08>;
				phandle = <0x08>;
			};
		};
	};

	fragment@7 {
		target = <0xffffffff>;

		__overlay__ {
			pinctrl-names = "pin_default\0pin_cfg";
			pinctrl-0 = <0x08>;
			pinctrl-1 = <0x09>;
			status = "okay";
		};
	};

	fragment@8 {
		target = <0xffffffff>;

		__overlay__ {
			accdet-mic-vol = <0x07>;
			headset-mode-setting = <0x500 0x500 0x01 0x1f0 0x800 0x800 0x20>;
			accdet-plugout-debounce = <0x14>;
			accdet-mic-mode = <0x01>;
			headset-three-key-threshold = <0x00 0x50 0xdc 0x1f4>;
			headset-four-key-threshold = <0x00 0x3a 0x79 0xc0 0x1c2>;
			pinctrl-names = "default\0state_eint_as_int";
			pinctrl-0 = <0x0a>;
			pinctrl-1 = <0x0b>;
			status = "okay";
		};
	};

	fragment@9 {
		target = <0xffffffff>;

		__overlay__ {

			accdet_default {
				linux,phandle = <0x0a>;
				phandle = <0x0a>;
			};

			accdet_gpio6_init {
				linux,phandle = <0x0b>;
				phandle = <0x0b>;

				pins_cmd_dat {
					pins = <0x600>;
					slew-rate = <0x00>;
					bias-disable;
				};
			};
		};
	};

	fragment@10 {
		target = <0xffffffff>;

		__overlay__ {
			tpd-resolution = <0x2d0 0x500>;
			use-tpd-button = <0x00>;
			tpd-key-num = <0x03>;
			tpd-key-local = <0x8b 0xac 0x9e 0x00>;
			tpd-key-dim-local = <0x5a 0x373 0x64 0x28 0xe6 0x373 0x64 0x28 0x172 0x373 0x64 0x28 0x00 0x00 0x00 0x00>;
			tpd-max-touch-num = <0x05>;
			tpd-filter-enable = <0x01>;
			tpd-filter-pixel-density = <0x7c>;
			tpd-filter-custom-prameters = <0x00 0x00 0x00 0x00 0x00 0x00 0x00 0x00 0x00 0x00 0x00 0x00>;
			tpd-filter-custom-speed = <0x00 0x00 0x00>;
			pinctrl-names = "default\0state_eint_as_int\0state_eint_output0\0state_eint_output1\0state_rst_output0\0state_rst_output1";
			pinctrl-0 = <0x0c>;
			pinctrl-1 = <0x0d>;
			pinctrl-2 = <0x0e>;
			pinctrl-3 = <0x0f>;
			pinctrl-4 = <0x10>;
			pinctrl-5 = <0x11>;
			status = "okay";
		};
	};

	fragment@11 {
		target = <0xffffffff>;

		__overlay__ {

			eint0default {
				linux,phandle = <0x0c>;
				phandle = <0x0c>;
			};

			eint@0 {
				linux,phandle = <0x0d>;
				phandle = <0x0d>;

				pins_cmd_dat {
					pinmux = <0xa00>;
					slew-rate = <0x00>;
					bias-disable;
				};
			};

			eintoutput0 {
				linux,phandle = <0x0e>;
				phandle = <0x0e>;

				pins_cmd_dat {
					pinmux = <0xa00>;
					slew-rate = <0x01>;
					output-low;
				};
			};

			eintoutput1 {
				linux,phandle = <0x0f>;
				phandle = <0x0f>;

				pins_cmd_dat {
					pinmux = <0xa00>;
					slew-rate = <0x01>;
					output-high;
				};
			};

			rstoutput0 {
				linux,phandle = <0x10>;
				phandle = <0x10>;

				pins_cmd_dat {
					pinmux = <0x2a00>;
					slew-rate = <0x01>;
					output-low;
				};
			};

			rstoutput1 {
				linux,phandle = <0x11>;
				phandle = <0x11>;

				pins_cmd_dat {
					pinmux = <0x2a00>;
					slew-rate = <0x01>;
					output-high;
				};
			};
		};
	};

	fragment@12 {
		target = <0xffffffff>;

		__overlay__ {

			flash0@0 {
				linux,phandle = <0x02>;
				phandle = <0x02>;

				pins_cmd_dat {
					pins = <0x2b00>;
					slew-rate = <0x01>;
					output-low;
				};
			};

			flash0@1 {
				linux,phandle = <0x03>;
				phandle = <0x03>;

				pins_cmd_dat {
					pins = <0x2b00>;
					slew-rate = <0x01>;
					output-high;
				};
			};

			flash1@0 {
				linux,phandle = <0x04>;
				phandle = <0x04>;

				pins_cmd_dat {
					pins = <0x1500>;
					slew-rate = <0x01>;
					output-low;
				};
			};

			flash1@1 {
				linux,phandle = <0x05>;
				phandle = <0x05>;

				pins_cmd_dat {
					pins = <0x1500>;
					slew-rate = <0x01>;
					output-high;
				};
			};

			flashdefault {
				linux,phandle = <0x01>;
				phandle = <0x01>;
			};
		};
	};

	fragment@13 {
		target = <0xffffffff>;

		__overlay__ {

			cam0@0 {
				linux,phandle = <0x13>;
				phandle = <0x13>;

				pins_cmd_dat {
					pinmux = <0x2c00>;
					slew-rate = <0x01>;
					output-low;
				};
			};

			cam0@1 {
				linux,phandle = <0x14>;
				phandle = <0x14>;

				pins_cmd_dat {
					pinmux = <0x2c00>;
					slew-rate = <0x01>;
					output-high;
				};
			};

			cam0@2 {
				linux,phandle = <0x15>;
				phandle = <0x15>;

				pins_cmd_dat {
					pinmux = <0x700>;
					slew-rate = <0x01>;
					output-low;
				};
			};

			cam0@3 {
				linux,phandle = <0x16>;
				phandle = <0x16>;

				pins_cmd_dat {
					pinmux = <0x700>;
					slew-rate = <0x01>;
					output-high;
				};
			};

			cam1@0 {
				linux,phandle = <0x17>;
				phandle = <0x17>;

				pins_cmd_dat {
					pinmux = <0xb00>;
					slew-rate = <0x01>;
					output-low;
				};
			};

			cam1@1 {
				linux,phandle = <0x18>;
				phandle = <0x18>;

				pins_cmd_dat {
					pinmux = <0xb00>;
					slew-rate = <0x01>;
					output-high;
				};
			};

			cam1@2 {
				linux,phandle = <0x19>;
				phandle = <0x19>;

				pins_cmd_dat {
					pinmux = <0xc00>;
					slew-rate = <0x01>;
					output-low;
				};
			};

			cam1@3 {
				linux,phandle = <0x1a>;
				phandle = <0x1a>;

				pins_cmd_dat {
					pinmux = <0xc00>;
					slew-rate = <0x01>;
					output-high;
				};
			};

			cam@0 {
				linux,phandle = <0x1b>;
				phandle = <0x1b>;

				pins_cmd_dat {
					pinmux = <0x4400>;
					slew-rate = <0x01>;
					output-low;
				};
			};

			cam@1 {
				linux,phandle = <0x1c>;
				phandle = <0x1c>;

				pins_cmd_dat {
					pinmux = <0x4400>;
					slew-rate = <0x01>;
					output-high;
				};
			};

			camdefault {
				linux,phandle = <0x12>;
				phandle = <0x12>;
			};
		};
	};

	fragment@14 {
		target = <0xffffffff>;

		__overlay__ {
			pinctrl-names = "default\0cam0_rst0\0cam0_rst1\0cam0_pnd0\0cam0_pnd1\0cam1_rst0\0cam1_rst1\0cam1_pnd0\0cam1_pnd1\0cam_ldo0_0\0cam_ldo0_1";
			pinctrl-0 = <0x12>;
			pinctrl-1 = <0x13>;
			pinctrl-2 = <0x14>;
			pinctrl-3 = <0x15>;
			pinctrl-4 = <0x16>;
			pinctrl-5 = <0x17>;
			pinctrl-6 = <0x18>;
			pinctrl-7 = <0x19>;
			pinctrl-8 = <0x1a>;
			pinctrl-9 = <0x1b>;
			pinctrl-10 = <0x1c>;
			status = "okay";
		};
	};

	fragment@15 {
		target = <0xffffffff>;

		__overlay__ {

			consys_default {
				linux,phandle = <0x1d>;
				phandle = <0x1d>;
			};

			gpslna@0 {
				linux,phandle = <0x1e>;
				phandle = <0x1e>;

				pins_cmd_dat {
					pinmux = <0x4f00>;
					slew-rate = <0x00>;
					bias-disable;
					output-low;
				};
			};

			gpslna@1 {
				linux,phandle = <0x1f>;
				phandle = <0x1f>;

				pins_cmd_dat {
					pinmux = <0x4f00>;
					slew-rate = <0x01>;
					output-high;
				};
			};

			gpslna@2 {
				linux,phandle = <0x20>;
				phandle = <0x20>;

				pins_cmd_dat {
					pinmux = <0x4f00>;
					slew-rate = <0x01>;
					output-low;
				};
			};
		};
	};

	fragment@16 {
		target = <0xffffffff>;

		__overlay__ {
			pinctrl-names = "default\0gps_lna_state_init\0gps_lna_state_oh\0gps_lna_state_ol";
			pinctrl-0 = <0x1d>;
			pinctrl-1 = <0x1e>;
			pinctrl-2 = <0x1f>;
			pinctrl-3 = <0x20>;
			status = "okay";
		};
	};

	fragment@17 {
		target = <0xffffffff>;

		__overlay__ {

			mtknfc {
				linux,phandle = <0x21>;
				phandle = <0x21>;
			};

			state_ven_high {
				linux,phandle = <0x22>;
				phandle = <0x22>;

				pins_cmd_dat {
					pinmux = <0x400>;
					slew-rate = <0x01>;
					output-high;
				};
			};

			state_ven_low {
				linux,phandle = <0x23>;
				phandle = <0x23>;

				pins_cmd_dat {
					pinmux = <0x400>;
					slew-rate = <0x01>;
					output-low;
				};
			};

			state_rst_high {
				linux,phandle = <0x24>;
				phandle = <0x24>;

				pins_cmd_dat {
					pinmux = <0x300>;
					slew-rate = <0x01>;
					output-high;
				};
			};

			state_rst_low {
				linux,phandle = <0x25>;
				phandle = <0x25>;

				pins_cmd_dat {
					pinmux = <0x300>;
					slew-rate = <0x01>;
					output-low;
				};
			};

			state_eint_high {
				linux,phandle = <0x26>;
				phandle = <0x26>;

				pins_cmd_dat {
					pinmux = <0x100>;
					slew-rate = <0x01>;
					output-high;
				};
			};

			state_eint_low {
				linux,phandle = <0x27>;
				phandle = <0x27>;

				pins_cmd_dat {
					pinmux = <0x100>;
					slew-rate = <0x01>;
					output-low;
				};
			};

			state_irq_init {
				linux,phandle = <0x28>;
				phandle = <0x28>;

				pins_cmd_dat {
					pinmux = <0x200>;
					slew-rate = <0x00>;
					bias-pull-down = <0x00>;
				};
			};
		};
	};

	fragment@18 {
		target = <0xffffffff>;

		__overlay__ {
			pinctrl-names = "mtknfc\0ven_high\0ven_low\0rst_high\0rst_low\0eint_high\0eint_low\0irq_init";
			pinctrl-0 = <0x21>;
			pinctrl-1 = <0x22>;
			pinctrl-2 = <0x23>;
			pinctrl-3 = <0x24>;
			pinctrl-4 = <0x25>;
			pinctrl-5 = <0x26>;
			pinctrl-6 = <0x27>;
			pinctrl-7 = <0x28>;
			status = "okay";
		};
	};

	fragment@19 {
		target = <0xffffffff>;

		__overlay__ {

			usb_default {
				linux,phandle = <0x29>;
				phandle = <0x29>;
			};

			iddig_irq_init {
				linux,phandle = <0x2a>;
				phandle = <0x2a>;

				pins_cmd_dat {
					pins = <0x01>;
					slew-rate = <0x00>;
					bias-pull-up = <0x00>;
				};
			};

			drvvbus_init {
				linux,phandle = <0x2b>;
				phandle = <0x2b>;

				pins_cmd_dat {
					pins = <0x5300>;
					slew-rate = <0x01>;
					bias-pull-down = <0x00>;
				};
			};

			drvvbus_low {
				linux,phandle = <0x2c>;
				phandle = <0x2c>;

				pins_cmd_dat {
					pins = <0x5300>;
					slew-rate = <0x01>;
					output-low;
					bias-pull-down = <0x00>;
				};
			};

			drvvbus_high {
				linux,phandle = <0x2d>;
				phandle = <0x2d>;

				pins_cmd_dat {
					pins = <0x5300>;
					slew-rate = <0x01>;
					output-high;
					bias-pull-down = <0x00>;
				};
			};
		};
	};

	fragment@20 {
		target = <0xffffffff>;

		__overlay__ {
			pinctrl-names = "usb_default\0iddig_irq_init\0drvvbus_init\0drvvbus_low\0drvvbus_high";
			pinctrl-0 = <0x29>;
			pinctrl-1 = <0x2a>;
			pinctrl-2 = <0x2b>;
			pinctrl-3 = <0x2c>;
			pinctrl-4 = <0x2d>;
			interrupt-parent = <0xffffffff>;
			interrupts = <0x00 0x08>;
			debounce = <0x09 0x00>;
			status = "okay";
		};
	};

	fragment@21 {
		target = <0xffffffff>;

		__overlay__ {
			#address-cells = <0x01>;
			#size-cells = <0x00>;

			camera_main_af@0c {
				compatible = "mediatek,camera_main_af";
				reg = <0x0c>;
				status = "okay";
				linux,phandle = <0x3c>;
				phandle = <0x3c>;
			};

			cap_touch@14 {
				compatible = "mediatek,cap_touch";
				reg = <0x14>;
				status = "okay";
				linux,phandle = <0x3d>;
				phandle = <0x3d>;
			};
		};
	};

	fragment@22 {
		target = <0xffffffff>;

		__overlay__ {
			#address-cells = <0x01>;
			#size-cells = <0x00>;

			i2c_lcd_bias@3e {
				compatible = "mediatek,i2c_lcd_bias";
				reg = <0x3e>;
				status = "okay";
				linux,phandle = <0x3e>;
				phandle = <0x3e>;
			};

			swithing_charger@6a {
				compatible = "mediatek,swithing_charger";
				reg = <0x6a>;
				status = "okay";
				linux,phandle = <0x3f>;
				phandle = <0x3f>;
			};
		};
	};

	fragment@23 {
		target = <0xffffffff>;

		__overlay__ {
			#address-cells = <0x01>;
			#size-cells = <0x00>;

			msensor@0d {
				compatible = "mediatek,msensor";
				reg = <0x0d>;
				status = "okay";
				linux,phandle = <0x40>;
				phandle = <0x40>;
			};

			gyro@68 {
				compatible = "mediatek,gyro";
				reg = <0x68>;
				status = "okay";
				linux,phandle = <0x41>;
				phandle = <0x41>;
			};

			gsensor@18 {
				compatible = "mediatek,gsensor";
				reg = <0x18>;
				status = "okay";
				linux,phandle = <0x42>;
				phandle = <0x42>;
			};

			alsps@23 {
				compatible = "mediatek,alsps";
				reg = <0x23>;
				status = "okay";
				interrupt-parent = <0xffffffff>;
				interrupts = <0x41 0x08>;
				debounce = <0x41 0x00>;
				linux,phandle = <0x43>;
				phandle = <0x43>;
			};

			nfc@28 {
				compatible = "mediatek,nfc";
				reg = <0x28>;
				status = "okay";
				linux,phandle = <0x44>;
				phandle = <0x44>;
			};

			strobe_main@63 {
				compatible = "mediatek,strobe_main";
				reg = <0x63>;
				status = "okay";
				linux,phandle = <0x45>;
				phandle = <0x45>;
			};
		};
	};

	fragment@24 {
		target = <0xffffffff>;

		__overlay__ {
			#address-cells = <0x01>;
			#size-cells = <0x00>;

			camera_main@20 {
				compatible = "mediatek,camera_main";
				reg = <0x20>;
				status = "okay";
				linux,phandle = <0x46>;
				phandle = <0x46>;
			};

			camera_sub@6e {
				compatible = "mediatek,camera_sub";
				reg = <0x6e>;
				status = "okay";
				linux,phandle = <0x47>;
				phandle = <0x47>;
			};
		};
	};

	fragment@25 {
		target = <0xffffffff>;

		__overlay__ {
			interrupt-parent = <0xffffffff>;
			interrupts = <0x05 0x08>;
			debounce = <0x05 0x3e8>;
			status = "okay";
		};
	};

	fragment@26 {
		target = <0xffffffff>;

		__overlay__ {
			interrupt-parent = <0xffffffff>;
			interrupts = <0x06 0x08>;
			debounce = <0x06 0x3e800>;
			status = "okay";
		};
	};

	fragment@27 {
		target = <0xffffffff>;

		__overlay__ {
			interrupt-parent = <0xffffffff>;
			interrupts = <0x09 0x08>;
			debounce = <0x09 0x00>;
			status = "okay";
		};
	};

	fragment@28 {
		target = <0xffffffff>;

		__overlay__ {
			interrupt-parent = <0xffffffff>;
			interrupts = <0x0a 0x02>;
			debounce = <0x0a 0x00>;
			status = "okay";
		};
	};

	fragment@29 {
		target = <0xffffffff>;

		__overlay__ {
			interrupt-parent = <0xffffffff>;
			interrupts = <0x13 0x08>;
			debounce = <0x13 0x00>;
			status = "okay";
		};
	};

	fragment@30 {
		target = <0xffffffff>;

		__overlay__ {
			interrupt-parent = <0xffffffff>;
			interrupts = <0x44 0x08>;
			debounce = <0x44 0x00>;
			status = "okay";
		};
	};

	fragment@31 {
		target = <0xffffffff>;

		__overlay__ {
			GPIO_SIM1_HOT_PLUG = <0x08>;
			GPIO_SIM2_SCLK = <0xa0>;
			GPIO_SIM2_SRST = <0xa1>;
			GPIO_SIM2_SIO = <0xa2>;
			GPIO_SIM1_SCLK = <0xa3>;
			GPIO_SIM1_SRST = <0xa4>;
			GPIO_SIM1_SIO = <0xa5>;
		};
	};

	fragment@32 {
		target = <0xffffffff>;

		__overlay__ {
		};
	};

	fragment@33 {
		target = <0xffffffff>;

		__overlay__ {
			regulator-name = "vcama";
			regulator-default-on = <0x00>;
			status = "okay";
		};
	};

	fragment@34 {
		target = <0xffffffff>;

		__overlay__ {
			regulator-name = "vsim1";
			regulator-default-on = <0x00>;
			status = "okay";
		};
	};

	fragment@35 {
		target = <0xffffffff>;

		__overlay__ {
			regulator-name = "vsim2";
			regulator-default-on = <0x00>;
			status = "okay";
		};
	};

	fragment@36 {
		target = <0xffffffff>;

		__overlay__ {
			regulator-name = "vcamaf";
			regulator-default-on = <0x00>;
			status = "okay";
		};
	};

	fragment@37 {
		target = <0xffffffff>;

		__overlay__ {
			regulator-name = "vgp1";
			regulator-default-on = <0x00>;
			status = "okay";
		};
	};

	fragment@38 {
		target = <0xffffffff>;

		__overlay__ {
			regulator-name = "vibr";
			regulator-default-on = <0x00>;
			status = "okay";
		};
	};

	fragment@39 {
		target = <0xffffffff>;

		__overlay__ {
			regulator-name = "vcamd";
			regulator-default-on = <0x00>;
			status = "okay";
		};
	};

	fragment@40 {
		target = <0xffffffff>;

		__overlay__ {
			regulator-name = "vcamio";
			regulator-default-on = <0x00>;
			status = "okay";
		};
	};

	fragment@41 {
		target = <0xffffffff>;

		__overlay__ {
			vcama-supply = <0xffffffff>;
			vcama_main2-supply = <0xffffffff>;
			vcama_sub-supply = <0xffffffff>;
			vcamaf-supply = <0xffffffff>;
			vcamaf_main2-supply = <0xffffffff>;
			vcamaf_sub-supply = <0xffffffff>;
			vcamd-supply = <0xffffffff>;
			vcamd_main2-supply = <0xffffffff>;
			vcamd_sub-supply = <0xffffffff>;
			vcamio-supply = <0xffffffff>;
			vcamio_main2-supply = <0xffffffff>;
			vcamio_sub-supply = <0xffffffff>;
			status = "okay";
		};
	};

	fragment@42 {
		target = <0xffffffff>;

		__overlay__ {
			vtouch-supply = <0xffffffff>;
			status = "okay";
		};
	};

	fragment@43 {
		target = <0xffffffff>;

		__overlay__ {

			adc_channel@ {
				compatible = "mediatek,adc_channel";
				mediatek,temperature0 = <0x00>;
				mediatek,temperature1 = <0x01>;
				mediatek,adc_fdd_rf_params_dynamic_custom_ch = <0x0c>;
				status = "okay";
			};
		};
	};

	fragment@44 {
		target = <0xffffffff>;

		__overlay__ {
			mediatek,clkbuf-quantity = <0x04>;
			mediatek,clkbuf-config = <0x02 0x01 0x01 0x01>;
			status = "okay";
		};
	};

	fragment@45 {
		target = <0xffffffff>;

		__overlay__ {
			mediatek,kpd-key-debounce = <0x400>;
			mediatek,kpd-sw-pwrkey = <0x74>;
			mediatek,kpd-hw-pwrkey = <0x08>;
			mediatek,kpd-sw-rstkey = <0x73>;
			mediatek,kpd-hw-rstkey = <0x11>;
			mediatek,kpd-use-extend-type = <0x00>;
			mediatek,kpd-hw-map-num = <0x48>;
			mediatek,kpd-hw-init-map = <0x72 0x00 0x00 0x00 0x00 0x00 0x00 0x00 0x00 0x00 0x00 0x00 0x00 0x00 0x00 0x00 0x00 0x00 0x00 0x00 0x00 0x00 0x00 0x00 0x00 0x00 0x00 0x00 0x00 0x00 0x00 0x00 0x00 0x00 0x00 0x00 0x00 0x00 0x00 0x00 0x00 0x00 0x00 0x00 0x00 0x00 0x00 0x00 0x00 0x00 0x00 0x00 0x00 0x00 0x00 0x00 0x00 0x00 0x00 0x00 0x00 0x00 0x00 0x00 0x00 0x00 0x00 0x00 0x00 0x00 0x00 0x00>;
			mediatek,kpd-pwrkey-eint-gpio = <0x00>;
			mediatek,kpd-pwkey-gpio-din = <0x00>;
			mediatek,kpd-hw-dl-key0 = <0x11>;
			mediatek,kpd-hw-dl-key1 = <0x00>;
			mediatek,kpd-hw-dl-key2 = <0x08>;
			mediatek,kpd-hw-recovery-key = <0x11>;
			mediatek,kpd-hw-factory-key = <0x00>;
			status = "okay";
		};
	};

	__symbols__ {
		cpu0 = "/fragment@1/__overlay__/cpu@000";
		cpu1 = "/fragment@1/__overlay__/cpu@001";
		cpu2 = "/fragment@1/__overlay__/cpu@002";
		cpu3 = "/fragment@1/__overlay__/cpu@003";
		led0 = "/fragment@3/__overlay__/led@0";
		led1 = "/fragment@3/__overlay__/led@1";
		led2 = "/fragment@3/__overlay__/led@2";
		led3 = "/fragment@3/__overlay__/led@3";
		led4 = "/fragment@3/__overlay__/led@4";
		led5 = "/fragment@3/__overlay__/led@5";
		led6 = "/fragment@3/__overlay__/led@6";
		kd_camera_flashlight = "/fragment@3/__overlay__/kd_camera_flashlight@0";
		vibrator0 = "/fragment@3/__overlay__/vibrator@0";
		nfc_sec = "/fragment@5/__overlay__/nfc@27";
		alsps_intpin_cfg = "/fragment@6/__overlay__/alspspincfg";
		alsps_intpin_default = "/fragment@6/__overlay__/alspsdefaultcfg";
		gyro_intpin_cfg = "/fragment@6/__overlay__/gyropincfg";
		gyro_intpin_default = "/fragment@6/__overlay__/gyrodefaultcfg";
		accdet_default = "/fragment@9/__overlay__/accdet_default";
		gpio6_accdet_iddig = "/fragment@9/__overlay__/accdet_gpio6_init";
		CTP_pins_default = "/fragment@11/__overlay__/eint0default";
		CTP_pins_eint_as_int = "/fragment@11/__overlay__/eint@0";
		CTP_pins_eint_output0 = "/fragment@11/__overlay__/eintoutput0";
		CTP_pins_eint_output1 = "/fragment@11/__overlay__/eintoutput1";
		CTP_pins_rst_output0 = "/fragment@11/__overlay__/rstoutput0";
		CTP_pins_rst_output1 = "/fragment@11/__overlay__/rstoutput1";
		flash_pins_flash0_state0 = "/fragment@12/__overlay__/flash0@0";
		flash_pins_flash0_state1 = "/fragment@12/__overlay__/flash0@1";
		flash_pins_flash1_state0 = "/fragment@12/__overlay__/flash1@0";
		flash_pins_flash1_state1 = "/fragment@12/__overlay__/flash1@1";
		flash_pins_default = "/fragment@12/__overlay__/flashdefault";
		camera_pins_cam0_rst0 = "/fragment@13/__overlay__/cam0@0";
		camera_pins_cam0_rst1 = "/fragment@13/__overlay__/cam0@1";
		camera_pins_cam0_pnd0 = "/fragment@13/__overlay__/cam0@2";
		camera_pins_cam0_pnd1 = "/fragment@13/__overlay__/cam0@3";
		camera_pins_cam1_rst0 = "/fragment@13/__overlay__/cam1@0";
		camera_pins_cam1_rst1 = "/fragment@13/__overlay__/cam1@1";
		camera_pins_cam1_pnd0 = "/fragment@13/__overlay__/cam1@2";
		camera_pins_cam1_pnd1 = "/fragment@13/__overlay__/cam1@3";
		camera_pins_cam_ldo0_0 = "/fragment@13/__overlay__/cam@0";
		camera_pins_cam_ldo0_1 = "/fragment@13/__overlay__/cam@1";
		camera_pins_default = "/fragment@13/__overlay__/camdefault";
		consys_pins_default = "/fragment@15/__overlay__/consys_default";
		gpslna_pins_init = "/fragment@15/__overlay__/gpslna@0";
		gpslna_pins_oh = "/fragment@15/__overlay__/gpslna@1";
		gpslna_pins_ol = "/fragment@15/__overlay__/gpslna@2";
		nfc_default = "/fragment@17/__overlay__/mtknfc";
		nfc_ven_high = "/fragment@17/__overlay__/state_ven_high";
		nfc_ven_low = "/fragment@17/__overlay__/state_ven_low";
		nfc_rst_high = "/fragment@17/__overlay__/state_rst_high";
		nfc_rst_low = "/fragment@17/__overlay__/state_rst_low";
		nfc_eint_high = "/fragment@17/__overlay__/state_eint_high";
		nfc_eint_low = "/fragment@17/__overlay__/state_eint_low";
		nfc_irq_init = "/fragment@17/__overlay__/state_irq_init";
		usb_default = "/fragment@19/__overlay__/usb_default";
		gpio0_mode1_iddig = "/fragment@19/__overlay__/iddig_irq_init";
		gpio83_mode2_drvvbus = "/fragment@19/__overlay__/drvvbus_init";
		gpio83_mode2_drvvbus_low = "/fragment@19/__overlay__/drvvbus_low";
		gpio83_mode2_drvvbus_high = "/fragment@19/__overlay__/drvvbus_high";
		camera_main_af_mtk = "/fragment@21/__overlay__/camera_main_af@0c";
		cap_touch_mtk = "/fragment@21/__overlay__/cap_touch@14";
		i2c_lcd_bias_mtk = "/fragment@22/__overlay__/i2c_lcd_bias@3e";
		swithing_charger_mtk = "/fragment@22/__overlay__/swithing_charger@6a";
		msensor_mtk = "/fragment@23/__overlay__/msensor@0d";
		gyro_mtk = "/fragment@23/__overlay__/gyro@68";
		gsensor_mtk = "/fragment@23/__overlay__/gsensor@18";
		alsps_mtk = "/fragment@23/__overlay__/alsps@23";
		nfc_mtk = "/fragment@23/__overlay__/nfc@28";
		strobe_main_mtk = "/fragment@23/__overlay__/strobe_main@63";
		camera_main_mtk = "/fragment@24/__overlay__/camera_main@20";
		camera_sub_mtk = "/fragment@24/__overlay__/camera_sub@6e";
	};

	__fixups__ {
		odm = "/fragment@0:target:0\0/fragment@3:target:0";
		cpus = "/fragment@1:target:0";
		bus = "/fragment@2:target:0";
		i2c0 = "/fragment@4:target:0\0/fragment@21:target:0";
		i2c2 = "/fragment@5:target:0\0/fragment@23:target:0";
		pio = "/fragment@6:target:0\0/fragment@9:target:0\0/fragment@11:target:0\0/fragment@12:target:0\0/fragment@13:target:0\0/fragment@15:target:0\0/fragment@17:target:0\0/fragment@19:target:0";
		gyro = "/fragment@7:target:0";
		accdet = "/fragment@8:target:0\0/fragment@26:target:0";
		touch = "/fragment@10:target:0\0/fragment@28:target:0\0/fragment@42:target:0";
		kd_camera_hw1 = "/fragment@14:target:0\0/fragment@41:target:0";
		consys = "/fragment@16:target:0";
		nfc = "/fragment@18:target:0";
		usbiddig = "/fragment@20:target:0";
		eintc = "/fragment@20/__overlay__:interrupt-parent:0\0/fragment@23/__overlay__/alsps@23:interrupt-parent:0\0/fragment@25/__overlay__:interrupt-parent:0\0/fragment@26/__overlay__:interrupt-parent:0\0/fragment@27/__overlay__:interrupt-parent:0\0/fragment@28/__overlay__:interrupt-parent:0\0/fragment@29/__overlay__:interrupt-parent:0\0/fragment@30/__overlay__:interrupt-parent:0\0/fragment@32:target:0";
		i2c1 = "/fragment@22:target:0";
		i2c3 = "/fragment@24:target:0";
		msdc1_ins = "/fragment@25:target:0";
		gse_1 = "/fragment@27:target:0";
		chr_stat = "/fragment@29:target:0";
		gse_2 = "/fragment@30:target:0";
		gpio_usage_mapping = "/fragment@31:target:0";
		mt_pmic_vcama_ldo_reg = "/fragment@33:target:0\0/fragment@41/__overlay__:vcama-supply:0\0/fragment@41/__overlay__:vcama_main2-supply:0\0/fragment@41/__overlay__:vcama_sub-supply:0";
		mt_pmic_vsim1_ldo_reg = "/fragment@34:target:0";
		mt_pmic_vsim2_ldo_reg = "/fragment@35:target:0";
		mt_pmic_vcam_af_ldo_reg = "/fragment@36:target:0\0/fragment@41/__overlay__:vcamaf-supply:0\0/fragment@41/__overlay__:vcamaf_main2-supply:0\0/fragment@41/__overlay__:vcamaf_sub-supply:0";
		mt_pmic_vgp1_ldo_reg = "/fragment@37:target:0\0/fragment@42/__overlay__:vtouch-supply:0";
		mt_pmic_vibr_ldo_reg = "/fragment@38:target:0";
		mt_pmic_vcamd_ldo_reg = "/fragment@39:target:0\0/fragment@41/__overlay__:vcamd-supply:0\0/fragment@41/__overlay__:vcamd_main2-supply:0\0/fragment@41/__overlay__:vcamd_sub-supply:0";
		mt_pmic_vcam_io_ldo_reg = "/fragment@40:target:0\0/fragment@41/__overlay__:vcamio-supply:0\0/fragment@41/__overlay__:vcamio_main2-supply:0\0/fragment@41/__overlay__:vcamio_sub-supply:0";
		auxadc = "/fragment@43:target:0";
		rf_clock_buffer_ctrl = "/fragment@44:target:0";
		keypad = "/fragment@45:target:0";
	};

	__local_fixups__ {

		fragment@3 {

			__overlay__ {

				kd_camera_flashlight@0 {
					pinctrl-0 = <0x00>;
					pinctrl-1 = <0x00>;
					pinctrl-2 = <0x00>;
					pinctrl-3 = <0x00>;
					pinctrl-4 = <0x00>;
				};
			};
		};

		fragment@5 {

			__overlay__ {

				alsps@23 {
					pinctrl-0 = <0x00>;
					pinctrl-1 = <0x00>;
				};
			};
		};

		fragment@7 {

			__overlay__ {
				pinctrl-0 = <0x00>;
				pinctrl-1 = <0x00>;
			};
		};

		fragment@8 {

			__overlay__ {
				pinctrl-0 = <0x00>;
				pinctrl-1 = <0x00>;
			};
		};

		fragment@10 {

			__overlay__ {
				pinctrl-0 = <0x00>;
				pinctrl-1 = <0x00>;
				pinctrl-2 = <0x00>;
				pinctrl-3 = <0x00>;
				pinctrl-4 = <0x00>;
				pinctrl-5 = <0x00>;
			};
		};

		fragment@14 {

			__overlay__ {
				pinctrl-0 = <0x00>;
				pinctrl-1 = <0x00>;
				pinctrl-2 = <0x00>;
				pinctrl-3 = <0x00>;
				pinctrl-4 = <0x00>;
				pinctrl-5 = <0x00>;
				pinctrl-6 = <0x00>;
				pinctrl-7 = <0x00>;
				pinctrl-8 = <0x00>;
				pinctrl-9 = <0x00>;
				pinctrl-10 = <0x00>;
			};
		};

		fragment@16 {

			__overlay__ {
				pinctrl-0 = <0x00>;
				pinctrl-1 = <0x00>;
				pinctrl-2 = <0x00>;
				pinctrl-3 = <0x00>;
			};
		};

		fragment@18 {

			__overlay__ {
				pinctrl-0 = <0x00>;
				pinctrl-1 = <0x00>;
				pinctrl-2 = <0x00>;
				pinctrl-3 = <0x00>;
				pinctrl-4 = <0x00>;
				pinctrl-5 = <0x00>;
				pinctrl-6 = <0x00>;
				pinctrl-7 = <0x00>;
			};
		};

		fragment@20 {

			__overlay__ {
				pinctrl-0 = <0x00>;
				pinctrl-1 = <0x00>;
				pinctrl-2 = <0x00>;
				pinctrl-3 = <0x00>;
				pinctrl-4 = <0x00>;
			};
		};
	};
};
